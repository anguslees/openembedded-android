## conf/distro/android.conf
```bitbake
#@TYPE: Distribution
#@NAME: Android
#@DESCRIPTION: Distribution configuration for Android

DISTRO_NAME = "android"
DISTRO_VERSION = "1.6"
TARGET_OS = "android"
TARGET_VENDOR = ""
DISTRO_FEATURES += "eabi"

INHERIT += "packaged-staging"
#INHERIT += "package_apk"
#PREFERRED_PKG_FORMAT = "apk"
INHERIT += "package_tar"
IMAGE_PKGTYPE = "ipk"
PREFERRED_PKG_FORMAT = "tar"
IMAGE_FSTYPES = "tar.gz"

# Android has a slightly unusual filesystem layout ...
#export base_prefix = "/system"
#export prefix = "/system"
#export exec_prefix = "/system"

#TOOLCHAIN_TYPE = "external"
#TOOLCHAIN_BRAND = "android"
LIBC = "bionic"
TOOLCHAIN_TYPE = "internal"

require conf/distro/include/sane-toolchain.inc
require conf/distro/include/toolchain-${TOOLCHAIN_TYPE}.inc
TARGET_VENDOR = ""

#TARGET_SYS_armv5te = arm-eabi

export TARGET_CPPFLAGS += "-DANDROID"
#export TARGET_CFLAGS += "-mandroid"
#export TARGET_CXXFLAGS += "-fno-exceptions -fno-rtti"
#export TARGET_LDFLAGS += "-Bdynamic -Wl,-dynamic-linker,/system/bin/linker -Wl,-z,nocopyreloc"
#ARCH_FLAGS_FOR_TARGET += "-mandroid"

PREFERRED_BINUTILS	= "2.20"
PREFERRED_GCC_VERSION	= "4.4.2"

# Compiler selection
PREFERRED_VERSION_android-ndk-bionic = "1.6_r1"

# Use limited Android-provided libstdc++ for now.
#PREFERRED_PROVIDER_libstdc++ = "bionic"
#PREFERRED_PROVIDER_libstdc++-dev = "bionic-dev"

ANDROID_ABI_SUBDIR_armv5te = "armeabi"
```

## conf/distro/include/bionic.inc
```bitbake
OVERRIDES .= ":libc-bionic"

PREFERRED_PROVIDER_virtual/libc = "bionic"
PREFERRED_PROVIDER_virtual/${TARGET_PREFIX}libc-initial = "bionic"
PREFERRED_PROVIDER_virtual/${TARGET_PREFIX}libc-for-gcc = "bionic"
```

## conf/distro/include/sane-toolchain-bionic.inc
```bitbake
# bionic

PREFERRED_PROVIDER_virtual/${TARGET_PREFIX}binutils = "binutils-cross"
PREFERRED_PROVIDER_virtual/${TARGET_PREFIX}libc-for-gcc = "android-ndk-bionic"
PREFERRED_PROVIDER_virtual/${TARGET_PREFIX}libc-initial = "android-ndk-bionic"
#PREFERRED_PROVIDER_linux-libc-headers = "linux-libc-headers"
PREFERRED_PROVIDER_linux-libc-headers = "android-ndk-bionic"
PREFERRED_PROVIDER_virtual/libc = "android-ndk-bionic"
PREFERRED_PROVIDER_virtual/libintl = "proxy-libintl"
PREFERRED_PROVIDER_virtual/libiconv = "libiconv"
PREFERRED_PROVIDER_libstdc++ = "android-ndk-bionic"
PREFERRED_PROVIDER_libstdc++-dev = "android-ndk-bionic"

USE_NLS ?= "no"
USE_NLS_glib-2.0 = "yes"
USE_NLS_glib-2.0-native = "yes"
USE_NLS_gcc-cross = "no"

#mess with compiler flags to use -Os instead of -O2
#Please see http://free-electrons.com/doc/embedded_linux_optimizations/img47.html for some more info
FULL_OPTIMIZATION = "-Os -fexpensive-optimizations -fomit-frame-pointer -frename-registers -funswitch-loops"
FULL_OPTIMIZATION += "${@['-finline-limit=64', '-finline-limit=300'][bb.data.getVar('ARM_INSTRUCTION_SET', d, 1) == 'thumb']}"

CXXFLAGS += "-fvisibility-inlines-hidden"
```

## conf/machine/android-generic-armeabi.conf
```bitbake
#@TYPE: Machine
#@NAME: Generic Android "armeabi"
#@DESCRIPTION: Machine configuration for Android "armeabi" architecture

TARGET_ARCH = "arm"

ARM_INSTRUCTION_SET = "thumb"
THUMB_INTERWORK = "yes"

MACHINE_FEATURES = "kernel26 touchscreen screen phone gps usbgadget bluetooth ext2 wifi"

require conf/machine/include/tune-xscale.inc
```
